/*                KEY POSITIONS
  ╭─────────────────────╮ ╭─────────────────────╮
  │  00  01  02  03  04 │ │  05  06  07  08  09 │
  │  10  11  12  13  14 │ │  15  16  17  18  19 │
  │  20  21  22  23  24 │ │  25  26  27  28  29 │
  ╰───────╮  30  31  32 │ │  33  34  35 ╭───────╯
          ╰─────────────╯ ╰─────────────╯ */

#define ALL 0xff
#define COMBO_TAB_MS 25
// use global-quick-tap-ms for combos (requires PR 1387)
#define COMBO_HOOK global-quick-tap-ms = <75>;

/ {
    combos {
        compatible = "zmk,combos";
#define CONCAT2(x, y) x ## y
#define CONCAT(x, y) CONCAT2(x, y)
#define COMBO(name, pos, k, l) CONCAT(combo_, name) { key-positions = <pos>; bindings = <k>; layers = <l>; timeout-ms = <COMBO_TAB_MS>; };
    // missing letters
        COMBO(x, 4 14, &kp X, BASE)
        COMBO(z, 5 15, &kp Z, BASE)
    // left-hand side combos
        COMBO(quit, 1 2, &kp LG(Q), BASE)
        COMBO(cltab, 2 3, &kp LG(W), BASE)
        COMBO(esc, 11 12, &kp ESCAPE, BASE)
        COMBO(tab, 12 13, &kp TAB, BASE)
        COMBO(copy, 21 22, &kp LG(C), BASE)
        COMBO(paste, 22 23, &kp LG(V), BASE)
        COMBO(cut, 21 22 23, &kp LG(X), BASE)
        COMBO(undo, 10 11, &kp LG(Z), BASE)
        COMBO(redo, 13 14, &kp LG(LS(Z)), BASE)
    // right-hand side combos
        COMBO(ret, 16 17 18, &kp RET, BASE)
        // parenthesis combos
        COMBO(lpar, 16 17, &kp LPAR, BASE SYM NUM)
        COMBO(rpar, 17 18, &kp RPAR, BASE SYM NUM)
        // brackets combos
        COMBO(lbkt, 26 27, &kp LBKT, BASE SYM NUM)
        COMBO(rbkt, 27 28, &kp RBKT, BASE SYM NUM)
        // braces combos
        // COMBO(lbrc, 26 27, &kp LBRC, BASE NUM)
        // COMBO(rbrc, 27 28, &kp RBRC, BASE NUM)
        // delete actions
        COMBO(bspc, 6 7, &kp BSPC, BASE NUM)
        COMBO(del, 7 8, &kp DEL, BASE NUM)
        COMBO(ctrl_bspc, 6 7 8, &kp LC(BSPC), BASE NUM)
        // lock layer
        COMBO(lock, 0 9 32 33, &tog LOCKL, BASE)
    };
};
