## app/boards/shields/chocofi/Kconfig.shield
```kconfig
config SHIELD_CHOCOFI_LEFT
	def_bool $(shields_list_contains,chocofi_left)

config SHIELD_CHOCOFI_RIGHT
	def_bool $(shields_list_contains,chocofi_right)
```

## config/boards/shields/chocofi/kconfig.deconfig
```kconfig
if SHIELD_CHOCOFI_LEFT

config ZMK_KEYBOARD_NAME
	default "Chocofi"

config ZMK_SPLIT_BLE_ROLE_CENTRAL
	default y

endif

if SHIELD_CHOCOFI_LEFT || SHIELD_CHOCOFI_RIGHT

config ZMK_SPLIT
	default y

endif
```

## config/boards/shields/zilpzalp/Kconfig.defconfig
```kconfig
# Copyright (c) 2022 The ZMK Contributors
# SPDX-License-Identifier: MIT

if SHIELD_ZILPZALP

config ZMK_KEYBOARD_NAME
    default "zilpzalp"

endif
```

## config/boards/shields/zilpzalp/Kconfig.shield
```kconfig
# Copyright (c) 2022 The ZMK Contributors
# SPDX-License-Identifier: MIT

config SHIELD_ZILPZALP
    def_bool $(shields_list_contains,zilpzalp)
```
